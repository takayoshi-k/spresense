## examples/lwm2mlight/Kconfig
```kconfig
config EXAMPLES_LWM2MLIGHT
	bool "wakaama LwM2M lightclient sample"
	default n
	---help---
		Enable the lwm2mlight app

if EXAMPLES_LWM2MLIGHT

config EXAMPLES_LWM2MLIGHT_PROGNAME
	string "Program name"
	default "lwm2mlight"
	depends on BUILD_KERNEL
	---help---
		This is the name of the program that will be use when the NSH ELF
		program is installed.

config EXAMPLES_LWM2MLIGHT_PRIORITY
	int "lwm2mlight task priority"
	default 100

config EXAMPLES_LWM2MLIGHT_STACKSIZE
	int "lwm2mlight stack size"
	default 8192

endif
```

## examples/tf_helloworld/Kconfig
```kconfig
config EXAMPLES_TF_HELLOWORLD
	tristate "Tensorflow lite micro Hello World example"
	default y
	---help---
		Enable the tf_helloworld app

if EXAMPLES_TF_HELLOWORLD

config EXAMPLES_TF_HELLOWORLD_PROGNAME
	string "Program name"
	default "tf_helloworld"
	---help---
		This is the name of the program that will be use when the NSH ELF
		program is installed.

config EXAMPLES_TF_HELLOWORLD_PRIORITY
	int "tf_helloworld task priority"
	default 100

config EXAMPLES_TF_HELLOWORLD_STACKSIZE
	int "tf_helloworld stack size"
	default 16384

config EXAMPLES_TF_HELLOWORLD_DEBUGLOG
	bool "tf_helloworld Debug log Enable"
	default n

config EXAMPLES_TF_HELLOWORLD_TENSORFLOW_VERSION
	string "Version TAG of Tensorflow to download "
	default "v2.3.0"

endif
```

## examples/uap_rx/Kconfig
```kconfig
#
# For a description of the syntax of this configuration file,
# see the file kconfig-language.txt in the NuttX tools repository.
#

config EXAMPLES_UAP_RX
	tristate "Underwater Acoustic Positioning System RX example"
	default n
	depends on CXD56_AUDIO
	---help---
		Enable the Underwater Acoustic Positioning System RX example

if EXAMPLES_UAP_RX

config EXAMPLES_UAP_RX_PROGNAME
	string "Program name"
	default "uap_rx"

config EXAMPLES_UAP_RX_PRIORITY
	int "Audio capture & oscillator task priority"
	default 100

config EXAMPLES_UAP_RX_STACKSIZE
	int "Audio capture & oscillator stack size"
	default 2048

config EXAMPLES_AUDIO_OSCILLATOR_USEPOSTPROC
    bool "Use Posstprocess"
    default n

endif
```

## examples/uprecg/Kconfig
```kconfig
config EXAMPLES_UPRECG
	bool "Update Recognized Number for Test"
	default n
	---help---
		Enable the uprecg app

if EXAMPLES_UPRECG

config EXAMPLES_UPRECG_PROGNAME
	string "Program name"
	default "uprecg"
	depends on BUILD_KERNEL
	---help---
		This is the name of the program that will be use when the NSH ELF
		program is installed.

config EXAMPLES_UPRECG_PRIORITY
	int "uprecg task priority"
	default 100

config EXAMPLES_UPRECG_STACKSIZE
	int "uprecg stack size"
	default 2048

endif
```

## sdk/m2m-defconfig
```kconfig
CONFIG_EXAMPLES_LTE_LWM2M=y
CONFIG_EXAMPLES_LTE_LWM2M_PRIORITY=100
CONFIG_EXAMPLES_LTE_LWM2M_STACKSIZE=8192
CONFIG_EXAMPLES_LTE_LWM2M_APN_NAME="iijmio.jp"
CONFIG_EXAMPLES_LTE_LWM2M_APN_IPTYPE=0
CONFIG_EXAMPLES_LTE_LWM2M_APN_AUTHTYPE=1
CONFIG_EXAMPLES_LTE_LWM2M_APN_USERNAME="mio@iij"
CONFIG_EXAMPLES_LTE_LWM2M_APN_PASSWD="iij"
```
